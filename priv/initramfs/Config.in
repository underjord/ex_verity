## priv/initramfs/Config.in
```kconfig
# Custom packages

source "$BR2_EXTERNAL_CUSTOM_PATH/package/nerves_key/Config.in"
source "$BR2_EXTERNAL_CUSTOM_PATH/package/rpi_otp_key/Config.in"
```

## priv/initramfs/configs/rpi4_defconfig
```kconfig
BR2_aarch64=y
BR2_TOOLCHAIN_EXTERNAL=y
BR2_TOOLCHAIN_EXTERNAL_CUSTOM=y
BR2_TOOLCHAIN_EXTERNAL_DOWNLOAD=y
BR2_TOOLCHAIN_EXTERNAL_URL="https://github.com/nerves-project/toolchains/releases/download/v13.2.0/nerves_toolchain_aarch64_nerves_linux_gnu-linux_${shell uname -m}-13.2.0-CE4B5F8.tar.xz"
BR2_TOOLCHAIN_EXTERNAL_CUSTOM_PREFIX="aarch64-nerves-linux-gnu"
BR2_TOOLCHAIN_EXTERNAL_GCC_13=y
BR2_TOOLCHAIN_EXTERNAL_HEADERS_5_4=y
BR2_TOOLCHAIN_EXTERNAL_CUSTOM_GLIBC=y
# BR2_TOOLCHAIN_EXTERNAL_INET_RPC is not set
BR2_TOOLCHAIN_EXTERNAL_CXX=y
BR2_TOOLCHAIN_EXTERNAL_FORTRAN=y
BR2_TOOLCHAIN_EXTERNAL_OPENMP=y
BR2_STATIC_LIBS=y
BR2_REPRODUCIBLE=y
BR2_INIT_NONE=y
BR2_TARGET_ROOTFS_CPIO=y
BR2_TARGET_ROOTFS_CPIO_GZIP=y
BR2_PACKAGE_BUSYBOX_CONFIG="${ABS_DEFCONFIG_DIR}/busybox.config"
BR2_PACKAGE_CRYPTSETUP=y
BR2_PACKAGE_F2FS_TOOLS=y
BR2_PACKAGE_HOST_KMOD_ZSTD=y
BR2_PACKAGE_HOST_MTOOLS=y
BR2_PACKAGE_MTOOLS=y
BR2_PACKAGE_RPI_FIRMWARE=y
BR2_PACKAGE_RPI_FIRMWARE_CUSTOM_VERSION="38d3dfafad92577c9e295fa3b7e5ec29adde94c5"
BR2_PACKAGE_RPI_FIRMWARE_VARIANT_PI4_X=y
BR2_PACKAGE_RPI_USERLAND=y
BR2_PACKAGE_UTIL_LINUX_BINARIES=y
BR2_PACKAGE_UTIL_LINUX_MOUNTPOINT=y
BR2_PACKAGE_UTIL_LINUX_PIVOT_ROOT=y
# BR2_TARGET_ENABLE_ROOT_LOGIN is not set
# BR2_SYSTEM_BIN_SH_NONE=y
# BR2_TARGET_GENERIC_GETTY is not set
BR2_ROOTFS_POST_BUILD_SCRIPT="${BR2_EXTERNAL_CUSTOM_PATH}/board/nerves_initramfs/post-build.sh"
# BR2_PACKAGE_IFUPDOWN_SCRIPTS is not set
# BR2_TARGET_ROOTFS_TAR is not set
```

## priv/initramfs/package/nerves_key/Config.in
```kconfig
config BR2_PACKAGE_NERVES_KEY
	bool "nerves_key"
	help
	  A utility for operating a NervesKey

config BR2_PACKAGE_NERVES_KEY_DEBUG
	bool "nerves_key debug"
	help
	  Enable debug output
```

## priv/initramfs/package/rpi_otp_key/Config.in
```kconfig
config BR2_PACKAGE_RPI_OTP_KEY
	bool "rpi_otp_key"
	help
	  A utility for reading Raspberry Pi OTP key material

config BR2_PACKAGE_RPI_OTP_KEY_DEBUG
	bool "rpi_otp_key debug"
	help
	  Enable debug output
```

## priv/initramfs/package/verity_init/Config.in
```kconfig
config BR2_PACKAGE_VERITY_INIT
	bool "verity_init"
	help
	  Init program for dm-verity verified boot initramfs

config BR2_PACKAGE_VERITY_INIT_DEBUG
	bool "verity_init debug"
	help
	  Enable debug output
```
